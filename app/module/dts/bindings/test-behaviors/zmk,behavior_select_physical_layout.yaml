## app/module/dts/bindings/test-behaviors/zmk,behavior_select_physical_layout.yaml
```yaml
# Copyright (c) 2025 The ZMK Contributors
# SPDX-License-Identifier: MIT

description: Physical Layout Selector Behavior (testing only)

compatible: "zmk,behavior-select-physical-layout"

include: one_param.yaml
```
